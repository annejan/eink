#include <util/delay.h>
//172*72
#define nDC_H digitalWrite(8,HIGH)
#define nDC_L digitalWrite(8,LOW)
#define nCS_H digitalWrite(10,HIGH)
#define nCS_L digitalWrite(10,LOW)
#define SDA_H digitalWrite(11,HIGH)
#define SDA_L digitalWrite(11,LOW)
#define SCLK_H digitalWrite(13,HIGH)
#define SCLK_L digitalWrite(13,LOW)
#define nRST_H digitalWrite(12,HIGH)
#define nRST_L digitalWrite(12,LOW)
#define a digitalRead(9)
 
const unsigned char init_data[]={ 
0x82,0x00,0x00,0x00,0xAA,0x00,0x00,0x00, 
0xAA,0xAA,0x00,0x00,0xAA,0xAA,0xAA,0x00, 
0x55,0xAA,0xAA,0x00,0x55,0x55,0x55,0x55, 
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0x00,0x00,};//waveform 
 
const unsigned char PROGMEM gImage[3096] = { /* 0X11,0X02,0X00,0XAC,0X00,0X48, */
0X00,0X00,0X00,0X00,0X00,0X00,0X00,0X00,0X00,0X00,0X00,0X00,0X00,0X03,0XFF,0XFF,
0XFF,0XFF,0X00,0X00,0X00,0X00,0X0F,0X40,0X00,0X00,0X02,0XC0,0X0B,0XE0,0X00,0X03,
0XFF,0XFF,0XFF,0XFF,0X00,0X00,0X01,0XF8,0X0F,0XC0,0X00,0X00,0X0F,0X80,0X3F,0XF0,
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0X00,0X00,0X00,0X00,0X00,0X00,0X00,0X00,};

const unsigned char PROGMEM ajImage[3096] = { /* 0X11,0X02,0X00,0XAC,0X00,0X48, */
0X00,0X00,0X00,0X00,0X00,0X00,0X00,0X00,0X00,0X00,0X00,0X00,0X00,0X00,0X00,0X00,
0X00,0X00,0X00,0X00,0X00,0X00,0X00,0X00,0X00,0X00,0X00,0X00,0X00,0X00,0X00,0X00,
0X00,0XFF,0XFF,0XC0,0X00,0X00,0X00,0X00,0X00,0X00,0X00,0X00,0X00,0X00,0X00,0X00,
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0X00,0X00,0X00,0X00,0X00,0X00,0X00,0X00,};

void DELAY_mS(int delaytime) //???? 
{ 
   while(delaytime--)_delay_ms(1);
}
 
void RESET() 
{ 
  nRST_L; 
  DELAY_mS(1);//1ms 
  nRST_H; 
  DELAY_mS(1);//1ms 
} 
 
void SPI4W_WRITECOM(unsigned char INIT_COM) 
{ 
  unsigned char TEMPCOM; 
  unsigned char scnt; 
 
  TEMPCOM=INIT_COM; 
  nCS_H; 
  nCS_L; 
  SCLK_L; 
  nDC_L; 
  for(scnt=0;scnt<8;scnt++) 
  { 
    if(TEMPCOM&0x80)  SDA_H; 
    else SDA_L; 
    SCLK_H; 
    SCLK_L; 
    TEMPCOM=TEMPCOM<<1; 
  } 
  nCS_H; 
} 
 
void SPI4W_WRITEDATA(unsigned char INIT_DATA) 
{ 
  unsigned char TEMPCOM; 
  unsigned char scnt; 
  TEMPCOM=INIT_DATA; 
  nCS_H; 
  nCS_L; 
  SCLK_L; 
  nDC_H; 
  for(scnt=0;scnt<8;scnt++) 
  { 
    if(TEMPCOM&0x80)   SDA_H; 
    else  SDA_L; 
    SCLK_H; 
    SCLK_L; 
    TEMPCOM=TEMPCOM<<1; 
  } 
  nCS_H; 
  nDC_L; 
} 
 
void WRITE_LUT() 
{ 
  unsigned char i; 
  SPI4W_WRITECOM(0x32);//write LUT register 
  for(i=0;i<90;i++) 
  {
    SPI4W_WRITEDATA(init_data[i]);
  }
} 
 
void INIT_SPD2701() 
{ 
  SPI4W_WRITECOM(0x03);//set PREVGH,PREVGL
  SPI4W_WRITEDATA(0x00); 
  SPI4W_WRITECOM(0x10);//set no deep sleep mode 
  SPI4W_WRITEDATA(0x00); 
  SPI4W_WRITECOM(0x11);//data enter mode 
  SPI4W_WRITEDATA(0x01); 
  SPI4W_WRITECOM(0x44);//setRAM x address start/end 
  SPI4W_WRITEDATA(0x00);//RAM x address start at 00h; 
  SPI4W_WRITEDATA(0x11);//RAMx address end at 11h(17)->72  
  SPI4W_WRITECOM(0x45);//set RAM y address start/end 
  SPI4W_WRITEDATA(0xAB);//RAM y address start at 00h; 
  SPI4W_WRITEDATA(0x00);//RAM y address start at ABh(171)->172 
  SPI4W_WRITECOM(0x4E);//set RAM x address count to 0; 
  SPI4W_WRITEDATA(0x00); 
  SPI4W_WRITECOM(0x4F);//set RAM y address count to 0; 
  SPI4W_WRITEDATA(0xAB); 
  SPI4W_WRITECOM(0x21);//bypass RAM data 
  SPI4W_WRITEDATA(0x03); 
  SPI4W_WRITECOM(0xF0);//booster feedback used 
  SPI4W_WRITEDATA(0x1F); 
  SPI4W_WRITECOM(0x2C);//vcom voltage 
  SPI4W_WRITEDATA(0xA0); 
  SPI4W_WRITECOM(0x3C);//board voltage 
  SPI4W_WRITEDATA(0x63); 
  SPI4W_WRITECOM(0x22);//display updata sequence option ,in page 33 
  SPI4W_WRITEDATA(0xC4);//enable sequence: clk -> CP -> LUT -> pattern display 
  WRITE_LUT(); 
} 
 
void entersleep() 
{ 
  SPI4W_WRITECOM(0x22);//display updata sequence option 
  SPI4W_WRITEDATA(0x03); 
  SPI4W_WRITECOM(0x20); 
} 
 
void image_display(int wut) 
{ 
  char data;
  int i; 
  SPI4W_WRITECOM(0x24); 
  for(i=0;i<3096;i++) 
  { 
    if (wut == 1) {
      data = pgm_read_byte(&gImage[i]);
    } else {
       data = pgm_read_byte(&ajImage[i]);
    }
    SPI4W_WRITEDATA(~data); 
  } 
  SPI4W_WRITECOM(0x20); 
  entersleep(); 
} 
 
void setup() {
  // put your setup code here, to run once:
  pinMode(8,OUTPUT);
  pinMode(10,OUTPUT);
  pinMode(11,OUTPUT);
  pinMode(13,OUTPUT);
  pinMode(9,INPUT);
  Serial.begin(9600);
  RESET(); 
  INIT_SPD2701(); //while(1);
  image_display(1); 
}
 
void loop() {
  delay(5000);
  image_display(2); 
  delay(5000);
  image_display(1); 
}
